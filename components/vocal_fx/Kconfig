## components/vocal_fx/Kconfig
```kconfig
menu "Vocal FX"
config VOCAL_FX_ENABLE_PROFILING
    bool "Enable audio-path profiling"
    default y
    help
        Record section timings without logging in the audio path. Disable for
        production after performance validation.
config VOCAL_FX_PITCH_DEBUG
    bool "Enable low-priority pitch telemetry"
    default n
    help
        Print pitch state from the telemetry task. The detector and audio task
        never log, irrespective of this option.
choice VOXP4_OPERATION_MODE
    prompt "VoxP4 Firmware Operation Mode"
    default VOXP4_MODE_HEADLESS
    help
        Select the operational mode for VoxP4 bring-up and validation.

config VOXP4_MODE_HEADLESS
    bool "Headless DSP Timing and Memory Audit (Alpha 0.1A.1)"
    help
        Runs synthetic, real-time scheduler, throughput, and stress test suites
        headlessly without requiring external audio codecs or I2S connections.

config VOXP4_MODE_I2S_TX_TEST
    bool "Stage B1: PCM5102 DAC-Only Bring-Up (Sine/Silence/Integrity)"
    help
        Generates synthetic tones (-18, -12, -6 dBFS) to PCM5102 DAC.

config VOXP4_MODE_I2S_RX_TEST
    bool "Stage B2: PCM1808 ADC-Only Bring-Up (Peak/RMS/Alignment)"
    help
        Receives 24-bit audio from PCM1808 ADC and computes peak, RMS, and DC stats.

config VOXP4_MODE_I2S_BYPASS
    bool "Stage B3: Hardware Bypass (ADC -> Format Conv -> DAC)"
    help
        Direct hardware bypass: PCM1808 -> Format Conv -> PCM5102 (no DSP).

config VOXP4_MODE_I2S_B4A_QUIESCENT
    bool "Stage B4A: Quiescent Full DSP Stress (Real ADC Quiescent -> DSP -> DAC)"
    help
        Full real-time vocal processor chain with real analog quiescent input from PCM1808.

config VOXP4_MODE_I2S_B4B_SYNTHETIC_VOICED
    bool "Stage B4B: Synthetic Voiced Full DSP Stress (Real DMA + Harmonic Voice -> DSP -> DAC)"
    help
        Full real-time vocal processor chain with deterministic synthetic harmonic voiced input.

config VOXP4_MODE_I2S_B4B_2_PITCH_WORKER_LOCK_AUDIT
    bool "Stage B4B.2: Pitch Worker Cadence & Lock Acquisition Audit"
    help
        Runs a 15-second constant 220 Hz pure-sine audit through the real RX/TX
        transport while measuring pitch-worker cadence, FIFO backlog, pitch-mark
        coherence, PSOLA activation, diagnostic queues, and safe teardown.

config VOXP4_MODE_I2S_B4B_3_PITCH_ANALYSIS_HOTSPOT_AUDIT
    bool "Stage B4B.3: Pitch Analysis Compute Hotspot Audit"
    help
        Runs a 10-second constant 220 Hz pure-sine audit through the real RX/TX
        transport and accounts for pitch-worker compute cost by internal
        PitchAnalysis, YIN, pitch-mark, and LPC section.

config VOXP4_MODE_I2S_B4B_4A_LPC_RING_BUFFER_AUDIT
    bool "Stage B4B.4A: LPC Ring Buffer Optimization Audit"
    help
        Repeats the 10-second B4B.3 hardware audit after the algorithm-preserving
        LPC circular-frame storage optimization and reports before/after costs.

config VOXP4_MODE_I2S_B4B_4B_LPC_AUTOCORR_AUDIT
    bool "Stage B4B.4B: LPC Autocorrelation Precision & FPU Audit"
    help
        Benchmarks double-reference, float-scalar, and float-multiacc LPC
        autocorrelation on identical frames, then repeats the 10-second B4B.4A
        full-worker audit without changing LPC cadence or scheduling.

config VOXP4_MODE_I2S_B4B_4C_COMPENSATED_AUTOCORR_AUDIT
    bool "Stage B4B.4C: Compensated FMA / Double-Single LPC Audit"
    help
        Benchmarks double-reference, float-multiacc, Kahan, FMA-product, and
        double-single LPC autocorrelation on identical frames. The full worker
        uses double-single only after host numerical and audio guardrails pass.

config VOXP4_MODE_I2S_B4B_4D_YIN_DIFFERENCE_AUDIT
    bool "Stage B4B.4D: YIN Difference Kernel Optimization Audit"
    help
        Benchmarks the preserved scalar oracle and scalar/multi-accumulator
        FMA candidates on identical YIN windows, then runs the approved kernel
        in the unchanged 10-second full-worker hardware audit.

config VOXP4_MODE_I2S_B4B_4E_INCREMENTAL_YIN_AUDIT
    bool "Stage B4B.4E: Incremental / Sliding YIN Difference Audit"
    help
        Benchmarks persistent float and compensated binary32 sliding YIN
        candidates against the preserved FMA_8ACC oracle, then runs the
        eligible production candidate in the unchanged full-worker audit.

config VOXP4_MODE_I2S_B4B_4F_PITCH_MARK_NCC_AUDIT
    bool "Stage B4B.4F: Pitch-Mark NCC Kernel & Passive Alignment Audit"
    help
        Benchmarks the preserved pitch-mark NCC oracle and mathematically
        equivalent candidates, then runs the eligible kernel in the unchanged
        full-worker audit while observing source-to-mark grain alignment.

config VOXP4_MODE_I2S_B4B_4G_LPC_WINDOWING_AUDIT
    bool "Stage B4B.4G: LPC Windowing & Energy Kernel Audit"
    help
        Benchmarks the preserved runtime-Hann oracle, cached-Hann candidate,
        compensated F32 energy, and diagnostic autocorrelation-r0 energy, then
        runs the eligible windowing kernel in the unchanged full-worker audit.

config VOXP4_MODE_I2S_B4B_4H_LPC_ENERGY_QUALIFICATION
    bool "Stage B4B.4H: LPC Compensated F32 Energy Qualification"
    help
        Qualifies compensated-F32 frame-energy accumulation against the
        retained precomputed-Hann/double-energy production oracle, then runs
        the eligible candidate in the unchanged 10-second full-worker audit.

config VOXP4_MODE_I2S_B4C_4_SINGLE_GRAIN_DEFERRED
    bool "Stage B4C.4: Single-Grain Cost Attribution & Deferred Grain-Slice Rendering"
    help
        Isolates single-grain costs, benchmark kernel alternatives (scalar, multi2, multi4, multi8, multi_fma),
        and qualifies deferred grain-slice rendering with zero latency and flattened realtime workload.

config VOXP4_MODE_I2S_B4C_4A_DEFERRED_STANDALONE
    bool "Stage B4C.4A: Deferred Harmonizer Standalone Realtime Qualification"
    help
        Freezes production deferred grain-slice harmonizer, isolates optional FX,
        and qualifies standalone harmonizer realtime safety across all pitches and transitions.

config VOXP4_MODE_I2S_B4C_6A_TIMING_FORENSICS
    bool "Stage B4C.6A: End-to-End Audio Loop Timing Forensics"
    help
        Freezes the DSP path and records wall-clock RX, conversion, DSP, TX,
        inter-iteration, partial-transfer, and transport timing.  Reports are
        emitted only after each wall-clock qualification window.

config VOXP4_MODE_I2S_B4C_7_HARMONIZER_AUDIT
    bool "Stage B4C.7: 2-Voice Throughput, Cross-Voice Reuse & PSRAM 200 MHz"
    help
        Prestaged production-equivalent input, BOTH-ACTIVE classification,
        per-block DSP decomposition, exact source-slice reuse audit, LPC-order
        gate, and TX-prep decomposition. DSP semantics are frozen; only
        observability is added.

config VOXP4_MODE_I2S_B4C_8_DIAGNOSTIC
    bool "Stage B4C.8: Voice-Other Decomposition & Instrumentation-Overhead A/B (Diagnostic)"
    help
        Detailed Other-bucket decomposition with per-subcategory cycle counters,
        slow-block recorder, stall detector, and full section profiling.
        Uses identical DSP semantics to B4C.7; only observability is changed.
        Serial volume is high; run short windows only.

config VOXP4_MODE_I2S_B4C_8_QUALIFICATION
    bool "Stage B4C.8: Voice-Other Decomposition & Instrumentation-Overhead A/B (Qualification)"
    help
        Low-overhead qualification build for B4C.8 hardware acceptance.
        Retains only whole-DSP timer, deadline counter, minimal histogram,
        transport counters, and activity classifier. No per-sample trace,
        no detailed section timers, no diagnostic-ring writes.

config VOXP4_MODE_I2S_B4D_1_QUALIFICATION
    bool "Stage B4D.1: 1V Production Realtime Closure & Full-FX CPU Budget"
    help
        Cleaned steady-state qualification window for one harmony voice:
        explicit warmup, full counter/histogram/miss reset, per-block whole-DSP
        and whole-loop capture, MC x deadline-miss contingency, TX-prep
        breakdown, incremental compressor/delay/reverb budgets, Full-FX chain,
        and the worst-case F0 matrix.

config VOXP4_MODE_I2S_B4D_12_BURN_IN
    bool "Stage B4D.12: Physical Pass Qualification / Product Robustness Burn-In"
    help
        Qualifies the frozen 44.1 kHz S0 production architecture as a robust
        realtime audio product. Runs a layered burn-in campaign (deterministic
        reference, F0 stress, pitch-transition stress, harmony-interval stress,
        voiced/unvoiced and plosive stress, parameter/control stress, Full-FX
        and long-duration soaks) while collecting lightweight transport,
        deadline-miss, lateness-histogram, recovery, backlog, FIFO and memory
        telemetry. DSP semantics are frozen; only observability is added.

config VOXP4_MODE_I2S_B4C_REAL_ANALOG
    bool "Stage B4C: Real Analog Live Musical DSP (Real Mic/Instrument -> DSP -> DAC)"
    help
        Full real-time vocal processor chain preserved for live musical testing with real mic.

config VOXP4_MODE_I2S_FULL_DSP
    bool "Stage B4: Full VoxP4 Live DSP (Legacy / Default Full DSP)"
    help
        Full real-time vocal processor chain: PCM1808 -> DSP -> PCM5102.

config VOXP4_MODE_LATENCY_PULSE_TEST
    bool "Hardware Latency Pulse Test (Loopback / Timing Pulse)"
    help
        Emits sharp pulses for physical roundtrip / oscilloscope latency measurement.

config VOXP4_MODE_SAMPLE_FORMAT_FORENSIC
    bool "Sample Format Forensic Mode (Raw 256 words inspect)"
    help
        Captures and dumps first 256 raw words from RX DMA to verify bit alignment.
endchoice

config VOXP4_B4D12_REFERENCE_MINUTES
    int "B4D.12 deterministic reference soak duration (minutes)"
    depends on VOXP4_MODE_I2S_B4D_12_BURN_IN
    default 30
    help
        Duration of the Full-FX deterministic vocal-replay soak (Test A).

config VOXP4_B4D12_SAMPLE_RATE
    int "B4D.12 audio sample rate (44100 or 48000 Hz)"
    depends on VOXP4_MODE_I2S_B4D_12_BURN_IN
    range 44100 48000
    default 44100
    help
        Use 44100 for the reference forensic run or 48000 for the
        deadline comparison. Other rates in the range are not audited.

config VOXP4_B4D12_STRESS_SECONDS
    int "B4D.12 per-region stress window (seconds)"
    depends on VOXP4_MODE_I2S_B4D_12_BURN_IN
    default 20
    help
        Duration of each F0 / transition / interval / voiced-unvoiced /
        plosive stress region.

config VOXP4_B4D12_CONTROL_MINUTES
    int "B4D.12 parameter/control stress duration (minutes)"
    depends on VOXP4_MODE_I2S_B4D_12_BURN_IN
    default 10
    help
        Duration of the rapid parameter-control and effect enable/disable
        stress (Tests G/H/I).

config VOXP4_B4D12_SOAK_MINUTES
    int "B4D.12 long-duration production soak (minutes)"
    depends on VOXP4_MODE_I2S_B4D_12_BURN_IN
    default 240
    help
        Duration of the final continuous Full-FX production soak (Test J).
        The milestone minimum is 240 minutes (4 h).

config VOXP4_B4D12_SOAK_ONLY
    bool "B4D.12 run only the long-duration production soak"
    depends on VOXP4_MODE_I2S_B4D_12_BURN_IN
    default n
    help
        Skip campaign categories A..I and run only the steady Full-FX
        long-duration soak (Test J).  Used for a dedicated production soak
        without repeating the short stress matrix.

config VOXP4_PSOLA_PREDICTION_AUDIT_ONLY
    bool "Run only TD-PSOLA prediction feasibility cases"
    depends on VOXP4_MODE_I2S_B4D_12_BURN_IN
    default n
    help
        Run the reference vocal replay and two deterministic pitch-transition
        fixtures, then stop. This is a telemetry-only B4D.12 development mode.

config VOXP4_PSOLA_PREDICTION_RECORDER
    bool "Record detailed TD-PSOLA prediction snapshots"
    depends on VOXP4_PSOLA_PREDICTION_AUDIT_ONLY
    default y
    help
        Enable the bounded prediction snapshots. Disable for a paired timing
        baseline with the same short fixture campaign.

config VOXP4_HEADLESS_HW_TEST
    bool
    default y if VOXP4_MODE_HEADLESS
    default n

endmenu
```

## components/voxlink/Kconfig
```kconfig
menu "VoxLink control plane"
config VOXLINK_ENABLE_SERVER
    bool "Enable the VoxLink UART control server"
    default n
    help
        Starts the VoxLink v1 UART control task on the ESP32-P4. Disabled by
        default so the qualified realtime audio path is unchanged unless the
        control plane is explicitly requested. Enabling this does not alter the
        DSP topology, sample rate, block size or scheduler.
config VOXLINK_UART_PORT
    int "UART port number"
    range 0 2
    default 1
    depends on VOXLINK_ENABLE_SERVER
config VOXLINK_UART_BAUD
    int "VoxLink UART baud rate"
    default 921600
    depends on VOXLINK_ENABLE_SERVER
config VOXLINK_UART_TX_GPIO
    int "VoxLink UART TX GPIO (-1 = unassigned)"
    default -1
    depends on VOXLINK_ENABLE_SERVER
    help
        P4 TX -> CYD RX. Must be a free 3.3 V GPIO that does not collide with
        the I2S audio pins (GPIO19-23), the console/JTAG pins (GPIO37/38) or
        strapping pins. No final pin is assigned until verified against the
        WT9932P4-TINY schematic; -1 keeps the server disabled at runtime.
config VOXLINK_UART_RX_GPIO
    int "VoxLink UART RX GPIO (-1 = unassigned)"
    default -1
    depends on VOXLINK_ENABLE_SERVER
    help
        P4 RX <- CYD TX. Same constraints as the TX pin. -1 keeps the server
        disabled at runtime and prevents accidental binding of audio pins.
config VOXLINK_DEBUG_LOG
    bool "Log VoxLink handshake/command milestones"
    default n
    depends on VOXLINK_ENABLE_SERVER
    help
        Emit one DEBUG line per handshake milestone and per SET_PARAM on the
        control task. Never logs individual bytes and never runs on the audio
        task. Useful for the first physical bring-up.
endmenu
```
